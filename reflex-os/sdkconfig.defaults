## reflex-os/sdkconfig.defaults
```kconfig
# Reflex OS SDK Configuration
# Optimized for real-time performance

# Target: ESP32-C6
CONFIG_IDF_TARGET="esp32c6"

# CPU frequency: Maximum
CONFIG_ESP_DEFAULT_CPU_FREQ_MHZ_160=y
CONFIG_ESP_DEFAULT_CPU_FREQ_MHZ=160

# Optimization: Maximum speed
CONFIG_COMPILER_OPTIMIZATION_PERF=y

# FreeRTOS: Minimize overhead
CONFIG_FREERTOS_HZ=1000
CONFIG_FREERTOS_UNICORE=y
CONFIG_FREERTOS_ISR_STACKSIZE=4096

# Disable watchdog for benchmarking (re-enable for production)
CONFIG_ESP_TASK_WDT_EN=n
CONFIG_ESP_INT_WDT=n

# Console: USB Serial JTAG (built-in on ESP32-C6)
CONFIG_ESP_CONSOLE_USB_SERIAL_JTAG=y

# Flash: QIO mode for speed
CONFIG_ESPTOOLPY_FLASHMODE_QIO=y
CONFIG_ESPTOOLPY_FLASHFREQ_80M=y

# Logging: Minimal for performance
CONFIG_LOG_DEFAULT_LEVEL_WARN=y
CONFIG_LOG_DEFAULT_LEVEL=2

# PCNT: Place control functions in IRAM for ISR safety
# Required because pcnt_unit_clear_count() is called from LEVEL3 ISR
CONFIG_PCNT_CTRL_FUNC_IN_IRAM=y

# LP Core: Enable RISC-V low-power coprocessor
# The LP core runs a ternary geometric processor at ~16MHz / ~30μA
CONFIG_ULP_COPROC_ENABLED=y
CONFIG_ULP_COPROC_TYPE_LP_CORE=y
CONFIG_ULP_COPROC_RESERVE_MEM=16320
```
